## main/Kconfig.projbuild
```kconfig
menu "P4KVM HDMI → CSI"

    orsource "$IDF_PATH/examples/common_components/env_caps/$IDF_TARGET/Kconfig.env_caps"

    config P4KVM_TC358743_RST_GPIO
        int "TC358743 RESETN GPIO (active low; -1 if unused)"
        range -1 ENV_GPIO_RANGE_MAX
        default 23

    config P4KVM_JPEG_QUALITY
        int "JPEG quality 1-100"
        range 1 100
        default 70

    choice P4KVM_VIDEO_PIPELINE
        prompt "CSI capture pixel pipeline"
        default P4KVM_PIPELINE_RGB888
        help
            RGB888: TC358743 outputs RGB888 (CSI-2 DT 0x24), 6.2 MB per 1080p
            frame, JPEG encoder converts to 4:2:0 (smallest files on the wire).

            YUV422: TC358743 outputs UYVY422 (DT 0x1E), 4.1 MB per frame (one
            third less MIPI and CSI-DMA bandwidth), fed directly to the JPEG
            encoder - hardware-verified that the encoder's byte order is
            U Y V Y, i.e. native UYVY (its "YVYU" format id names the 32-bit
            word value). Output JPEG is 4:2:2, somewhat larger on the wire at
            equal quality than RGB888's 4:2:0. Compare both with /stats; the
            bottleneck (PSRAM vs Ethernet) decides which wins.

        config P4KVM_PIPELINE_RGB888
            bool "RGB888 (JPEG 4:2:0 output)"

        config P4KVM_PIPELINE_YUV422
            bool "YUV422 direct (JPEG 4:2:2 output)"

    endchoice

    config P4KVM_TEST_PATTERN
        bool "Animated test pattern instead of HDMI capture"
        default n
        help
            Replaces the TC358743/CSI capture with a CPU-generated animated
            color-bar pattern (sweeping stripe, same resolution and pixel
            format as the selected pipeline). Lets you exercise the whole
            chain - BitScrambler reorder, hardware JPEG, HTTP streaming, web
            UI, HID - on a bare ESP32-P4 board without the HDMI-CSI module
            attached.

    config P4KVM_ATX_POWER_GPIO
        int "ATX power button GPIO (-1 disabled)"
        range -1 ENV_GPIO_OUT_RANGE_MAX
        default -1
        help
            Drives the PC front-panel PWR_BTN header through an optocoupler or
            NPN transistor (never wire a GPIO to the header directly). Short
            press taps the button (~300 ms, ACPI power event); the UI's force-
            off holds it 5 s (ATX 4-second override).

    config P4KVM_ATX_RESET_GPIO
        int "ATX reset button GPIO (-1 disabled)"
        range -1 ENV_GPIO_OUT_RANGE_MAX
        default -1
        help
            Drives the PC front-panel RESET header (same isolation rules as
            the power button).

    config P4KVM_ATX_ACTIVE_HIGH
        bool "ATX press drives GPIO high"
        default y
        depends on P4KVM_ATX_POWER_GPIO >= 0 || P4KVM_ATX_RESET_GPIO >= 0
        help
            Yes for the usual NPN/optocoupler stage (GPIO high = button
            pressed). No if your circuit inverts.

    config P4KVM_AUDIO_ENABLE
        bool "Enable HDMI audio capture (I2S from TC358743)"
        default n
        help
            The TC358743 outputs the HDMI source's audio on its I2S pads (the
            bridge is I2S master; clocks derive from the HDMI stream). Jumper-
            wire the adapter's I2S BCK/LRCK(WS)/DATA pads to three P4 GPIOs
            and set them below. Audio streams to the browser as raw PCM S16LE
            48 kHz stereo over the /audio WebSocket (~1.5 Mbit/s), with a
            speaker toggle in the UI. Same idea as h2c-rpi on the Raspberry Pi.

    config P4KVM_AUDIO_I2S_BCK_GPIO
        int "I2S bit clock GPIO (-1 unset)"
        range -1 ENV_GPIO_IN_RANGE_MAX
        default -1
        depends on P4KVM_AUDIO_ENABLE

    config P4KVM_AUDIO_I2S_WS_GPIO
        int "I2S word select / LRCK GPIO (-1 unset)"
        range -1 ENV_GPIO_IN_RANGE_MAX
        default -1
        depends on P4KVM_AUDIO_ENABLE

    config P4KVM_AUDIO_I2S_DIN_GPIO
        int "I2S data GPIO (-1 unset)"
        range -1 ENV_GPIO_IN_RANGE_MAX
        default -1
        depends on P4KVM_AUDIO_ENABLE

    config P4KVM_WG_ENABLE
        bool "Enable WireGuard tunnel"
        default n
        help
            Brings up a WireGuard client tunnel (lwIP implementation) once the
            network has an IP and NTP time is synced. The KVM is then
            reachable at the tunnel-local IP from anywhere the peer routes -
            the intended remote-access path instead of exposing port 80.
            All keys are base64 strings as produced by `wg genkey`/`wg pubkey`.

    config P4KVM_WG_PRIVATE_KEY
        string "Interface private key (wg genkey)"
        default ""
        depends on P4KVM_WG_ENABLE

    config P4KVM_WG_LOCAL_IP
        string "Tunnel-local IP address"
        default "10.0.0.2"
        depends on P4KVM_WG_ENABLE

    config P4KVM_WG_LOCAL_NETMASK
        string "Tunnel netmask"
        default "255.255.255.0"
        depends on P4KVM_WG_ENABLE

    config P4KVM_WG_PEER_PUBLIC_KEY
        string "Peer public key (wg pubkey)"
        default ""
        depends on P4KVM_WG_ENABLE

    config P4KVM_WG_PRESHARED_KEY
        string "Preshared key (wg genpsk, optional)"
        default ""
        depends on P4KVM_WG_ENABLE

    config P4KVM_WG_ENDPOINT
        string "Peer endpoint (hostname or IP)"
        default ""
        depends on P4KVM_WG_ENABLE

    config P4KVM_WG_PORT
        int "Peer endpoint port"
        default 51820
        depends on P4KVM_WG_ENABLE

    config P4KVM_WG_KEEPALIVE
        int "Persistent keepalive seconds (0 disables)"
        range 0 65535
        default 25
        depends on P4KVM_WG_ENABLE
        help
            25 s is the conventional value to keep NAT/stateful-firewall
            mappings alive so the peer can reach the KVM unprompted.

    config P4KVM_AUTH_ENABLE
        bool "Require HTTP Basic authentication"
        default n
        help
            Protects all HTTP routes and the /ws input WebSocket with HTTP
            Basic auth. Credentials travel base64-encoded over plain HTTP, so
            this is a hurdle, not transport security: keep the device behind a
            VPN either way.

    config P4KVM_AUTH_USER
        string "Auth username"
        default "kvm"
        depends on P4KVM_AUTH_ENABLE

    config P4KVM_AUTH_PASS
        string "Auth password"
        default ""
        depends on P4KVM_AUTH_ENABLE
        help
            Empty password disables the check even when auth is enabled, to
            avoid locking yourself out with a half-configured build.

    config P4KVM_TC358743_ADV_DEBUG
        bool "Advanced TC358743 debugging (verbose stall / bridge logs + extra I2C reads)"
        default n
        help
            When enabled, CSI frame timeouts log extra TC358743 register state, AVI
            infoframe dumps, and periodic bridge status. Adds I2C traffic on error paths.
            Boot-time SYS_STATUS lines from init are unchanged.

    config P4KVM_ETH_ENABLE
        bool "Enable Ethernet (DHCP)"
        default y
        depends on SOC_EMAC_SUPPORTED

    config P4KVM_MDNS_HOSTNAME
        string "mDNS hostname (device is <name>.local)"
        default "p4kvm"
        help
            DNS label only: letters, digits, hyphen. Advertised over mDNS and
            sent as the DHCP client hostname when supported (Ethernet and WiFi).

    config P4KVM_WIFI_ENABLE
        bool "Enable WiFi station (via companion radio, e.g. onboard ESP32-C6)"
        default n
        help
            The ESP32-P4 has no radio; boards like the ESP32-P4-nano carry an
            ESP32-C6 wired over SDIO. This uses esp_wifi_remote + esp_hosted to
            drive it with the standard WiFi API. SDIO pins/transport are set in
            the esp_hosted component's own menuconfig section (defaults match
            the Espressif P4 reference design). Can run alongside Ethernet.
            Note the throughput: 1080p30 MJPEG at the default quality is
            ~40-70 Mbit/s; over WiFi expect to lower the JPEG quality or accept
            a lower frame rate.

    config P4KVM_WIFI_SSID
        string "WiFi SSID"
        default ""
        depends on P4KVM_WIFI_ENABLE

    config P4KVM_WIFI_PASSWORD
        string "WiFi password (empty for open network)"
        default ""
        depends on P4KVM_WIFI_ENABLE

    config P4KVM_ETH_RMII_CLK_GPIO
        int "RMII REFCLK GPIO (external input)"
        range ENV_GPIO_RANGE_MIN ENV_GPIO_RANGE_MAX
        default 50 if IDF_TARGET_ESP32P4
        default 0
        depends on P4KVM_ETH_ENABLE

    config P4KVM_ETH_RMII_TX_EN_GPIO
        int "RMII TX_EN"
        range ENV_GPIO_RANGE_MIN ENV_GPIO_OUT_RANGE_MAX
        default 49 if IDF_TARGET_ESP32P4
        default 0
        depends on P4KVM_ETH_ENABLE

    config P4KVM_ETH_RMII_TXD0_GPIO
        int "RMII TXD0"
        range ENV_GPIO_RANGE_MIN ENV_GPIO_OUT_RANGE_MAX
        default 34 if IDF_TARGET_ESP32P4
        default 0
        depends on P4KVM_ETH_ENABLE

    config P4KVM_ETH_RMII_TXD1_GPIO
        int "RMII TXD1"
        range ENV_GPIO_RANGE_MIN ENV_GPIO_OUT_RANGE_MAX
        default 35 if IDF_TARGET_ESP32P4
        default 0
        depends on P4KVM_ETH_ENABLE

    config P4KVM_ETH_RMII_CRS_DV_GPIO
        int "RMII CRS_DV"
        range ENV_GPIO_RANGE_MIN ENV_GPIO_IN_RANGE_MAX
        default 28 if IDF_TARGET_ESP32P4
        default 0
        depends on P4KVM_ETH_ENABLE

    config P4KVM_ETH_RMII_RXD0_GPIO
        int "RMII RXD0"
        range ENV_GPIO_RANGE_MIN ENV_GPIO_IN_RANGE_MAX
        default 29 if IDF_TARGET_ESP32P4
        default 0
        depends on P4KVM_ETH_ENABLE

    config P4KVM_ETH_RMII_RXD1_GPIO
        int "RMII RXD1"
        range ENV_GPIO_RANGE_MIN ENV_GPIO_IN_RANGE_MAX
        default 30 if IDF_TARGET_ESP32P4
        default 0
        depends on P4KVM_ETH_ENABLE

    config P4KVM_ETH_MDC_GPIO
        int "SMI MDC"
        range ENV_GPIO_RANGE_MIN ENV_GPIO_OUT_RANGE_MAX
        default 31 if IDF_TARGET_ESP32P4
        default 23
        depends on P4KVM_ETH_ENABLE

    config P4KVM_ETH_MDIO_GPIO
        int "SMI MDIO"
        range ENV_GPIO_RANGE_MIN ENV_GPIO_OUT_RANGE_MAX
        default 52 if IDF_TARGET_ESP32P4
        default 18
        depends on P4KVM_ETH_ENABLE

    config P4KVM_ETH_PHY_ADDR
        int "PHY address (-1 auto)"
        range -1 31
        default 1
        depends on P4KVM_ETH_ENABLE

    config P4KVM_ETH_PHY_RST_GPIO
        int "PHY reset GPIO (-1 none)"
        range -1 ENV_GPIO_OUT_RANGE_MAX
        default 51 if IDF_TARGET_ESP32P4
        default 5
        depends on P4KVM_ETH_ENABLE

endmenu
```
